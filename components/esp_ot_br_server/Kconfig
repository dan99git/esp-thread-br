## components/esp_ot_br_server/Kconfig
```kconfig
menu "ESP Thread Border Router Web"

    config ESP_BR_WEB_WRITE_AUTH
        bool "Protect Thread write routes"
        default y
        help
            Require a local admin password header before raw Thread write
            routes can change node state, datasets, prefixes, commissioner
            state, or network membership.

    config ESP_BR_WEB_ADMIN_PASSWORD
        string "Thread write-route admin password"
        default ""
        depends on ESP_BR_WEB_WRITE_AUTH
        help
            Password expected in the X-BOS-Admin-Password header for raw
            Thread write routes. If left empty while write auth is enabled,
            protected write routes reject every request.

endmenu
```

## examples/building_os_border_router/main/Kconfig.projbuild
```kconfig
menu "Building OS Border Router"

    config BOS_SERVER_DEFAULT_URL
        string "Building OS site server URL"
        default "http://192.168.88.253:7085"
        help
            Fallback BOS site server URL used when bos_reg/server_url is not
            present in NVS. Leave empty to disable firmware-initiated
            registration until a server URL is provisioned.

    config BOS_SERVER_API_KEY
        string "Building OS site server API key"
        default ""
        help
            Optional x-api-key value sent to the BOS site server. Use this
            when the site server has API_KEY configured.

endmenu
```
